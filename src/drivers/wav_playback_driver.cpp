#include "wav_playback_driver.h"

#include <Arduino.h>
#include <avr/io.h>
#include <avr/interrupt.h>
#include <util/atomic.h>

#include "mzio.h"
#include "monitor_mute.h"
#include "../streams/wav_sample_stream.h"

#if !defined(TIMER3_COMPA_vect)
#error "WAV playback driver requires Timer3 compare A on Arduino Mega 2560"
#endif

/*
    Timer3 CTC, prescaler 1:
      - one Compare-A event per WAV sample,
      - direct PE4 write in the ISR,
      - Timer1 is untouched and remains dedicated to WAV RECORD.

    The sample period is generated by fractional division of 16 MHz:
      44100 Hz -> alternating 362/363 clock intervals,
      22050 Hz -> alternating 725/726 clock intervals.
*/
static volatile uint8_t driver_state = WAV_PLAYBACK_DRIVER_STOPPED;

static uint16_t timer_sample_rate = 0U;
static uint16_t timer_base_ticks = 0U;
static uint16_t timer_remainder_ticks = 0U;
static uint16_t timer_phase_ticks = 0U;

static uint8_t cached_output_byte = 0U;
static uint8_t cached_output_bits = 0U;


static inline __attribute__((always_inline))
void wav_playback_schedule_period_from_isr(void)
{
    uint16_t ticks = timer_base_ticks;
    uint16_t phase = (uint16_t)(timer_phase_ticks + timer_remainder_ticks);

    if (phase >= timer_sample_rate)
    {
        phase = (uint16_t)(phase - timer_sample_rate);
        ticks++;
    }

    timer_phase_ticks = phase;
    OCR3A = (uint16_t)(ticks - 1U);
}

static inline __attribute__((always_inline))
void wav_playback_disable_timer_from_isr(void)
{
    TIMSK3 &= (uint8_t)~_BV(OCIE3A);
    TCCR3B = _BV(WGM32);
    TCCR3A = 0U;
    TIFR3 = _BV(OCF3A);
    monitor_set_tape_activity_from_isr(false);
}

static void wav_playback_disable_timer_from_foreground(bool force_read_low)
{
    ATOMIC_BLOCK(ATOMIC_RESTORESTATE)
    {
        TIMSK3 &= (uint8_t)~_BV(OCIE3A);
        TCCR3B = _BV(WGM32);
        TCCR3A = 0U;
        TIFR3 = _BV(OCF3A);
    }

    if (force_read_low)
    {
        mz_read_set(false);
    }
    monitor_disable();
}

static wav_playback_driver_state_t wav_playback_state_snapshot(void)
{
    uint8_t state;

    ATOMIC_BLOCK(ATOMIC_RESTORESTATE)
    {
        state = driver_state;
    }

    return (wav_playback_driver_state_t)state;
}

static inline __attribute__((always_inline))
bool wav_playback_load_cached_byte_from_isr(void)
{
    uint8_t valid_bits;

    if (!wav_sample_stream_pop_byte_fast_from_isr(
            &cached_output_byte, &valid_bits))
    {
        return false;
    }

    cached_output_bits = valid_bits;
    return true;
}

static inline __attribute__((always_inline))
bool wav_playback_emit_one_sample_from_isr(void)
{
    uint8_t level;

    if (cached_output_bits == 0U)
    {
        if (!wav_playback_load_cached_byte_from_isr())
        {
            return false;
        }
    }

    level = (uint8_t)(cached_output_byte & 1U);
    cached_output_byte >>= 1U;
    cached_output_bits--;

    /*
        D2 = PE4. This inline primitive contains no Arduino call, no callback
        and no buffer address calculation; one memory FIFO access happens only
        once per eight samples.
    */
    mz_read_set_fast_from_isr(level);

    return true;
}

static void wav_playback_enable_timer_from_foreground(void)
{
    ATOMIC_BLOCK(ATOMIC_RESTORESTATE)
    {
        TCNT3 = 0U;
        TIFR3 = _BV(OCF3A);
        TCCR3A = 0U;

        driver_state = WAV_PLAYBACK_DRIVER_RUNNING;
        monitor_set_tape_activity_from_isr(true);
        TIMSK3 |= _BV(OCIE3A);
        TCCR3B = (uint8_t)(_BV(WGM32) | _BV(CS30));
    }
}

void wav_playback_driver_init(void)
{
    mzio_init();

    ATOMIC_BLOCK(ATOMIC_RESTORESTATE)
    {
        TCCR3A = 0U;
        TCCR3B = _BV(WGM32);
        TCNT3 = 0U;
        OCR3A = 0xFFFFU;
        TIMSK3 &= (uint8_t)~_BV(OCIE3A);
        TIFR3 = _BV(OCF3A);
    }

    timer_sample_rate = 0U;
    timer_base_ticks = 0U;
    timer_remainder_ticks = 0U;
    timer_phase_ticks = 0U;
    cached_output_byte = 0U;
    cached_output_bits = 0U;
    driver_state = WAV_PLAYBACK_DRIVER_STOPPED;
}

bool wav_playback_driver_prepare(uint32_t sample_rate)
{
    uint32_t base_ticks;
    uint32_t remainder_ticks;

    if ((sample_rate == 0UL) || (sample_rate > 65535UL))
    {
        driver_state = WAV_PLAYBACK_DRIVER_BAD_ARGUMENT;
        return false;
    }

    base_ticks = (uint32_t)F_CPU / sample_rate;
    remainder_ticks = (uint32_t)F_CPU % sample_rate;

    if ((base_ticks == 0UL) || (base_ticks > 65535UL))
    {
        driver_state = WAV_PLAYBACK_DRIVER_BAD_RATE;
        return false;
    }

    wav_playback_disable_timer_from_foreground(true);

    ATOMIC_BLOCK(ATOMIC_RESTORESTATE)
    {
        TCNT3 = 0U;
        timer_sample_rate = (uint16_t)sample_rate;
        timer_base_ticks = (uint16_t)base_ticks;
        timer_remainder_ticks = (uint16_t)remainder_ticks;
        timer_phase_ticks = 0U;
        cached_output_byte = 0U;
        cached_output_bits = 0U;
        driver_state = WAV_PLAYBACK_DRIVER_READY;
    }

    return true;
}

bool wav_playback_driver_start(void)
{
    if (wav_playback_state_snapshot() != WAV_PLAYBACK_DRIVER_READY)
    {
        return false;
    }

    /*
        Output sample zero immediately, then begin the periodic Timer3 clock.
        This avoids one silent sample period at the start of every WAV.
    */
    if (!wav_playback_emit_one_sample_from_isr())
    {
        driver_state = wav_sample_stream_finished_fast_from_isr() ?
            WAV_PLAYBACK_DRIVER_FINISHED : WAV_PLAYBACK_DRIVER_UNDERRUN;
        return false;
    }

    wav_playback_schedule_period_from_isr();
    wav_playback_enable_timer_from_foreground();
    return true;
}

bool wav_playback_driver_pause(void)
{
    if (wav_playback_state_snapshot() != WAV_PLAYBACK_DRIVER_RUNNING)
    {
        return false;
    }

    /*
        Stop the sample clock but intentionally keep the last direct PE4 level.
    */
    wav_playback_disable_timer_from_foreground(false);

    ATOMIC_BLOCK(ATOMIC_RESTORESTATE)
    {
        driver_state = WAV_PLAYBACK_DRIVER_PAUSED;
    }

    return true;
}

bool wav_playback_driver_resume(void)
{
    if (wav_playback_state_snapshot() != WAV_PLAYBACK_DRIVER_PAUSED)
    {
        return false;
    }

    wav_playback_schedule_period_from_isr();
    wav_playback_enable_timer_from_foreground();
    return true;
}

void wav_playback_driver_stop(void)
{
    wav_playback_disable_timer_from_foreground(true);

    ATOMIC_BLOCK(ATOMIC_RESTORESTATE)
    {
        driver_state = WAV_PLAYBACK_DRIVER_STOPPED;
        cached_output_byte = 0U;
        cached_output_bits = 0U;
    }
}

wav_playback_driver_state_t wav_playback_driver_get_state(void)
{
    return wav_playback_state_snapshot();
}

uint32_t wav_playback_driver_get_sample_rate(void)
{
    return (uint32_t)timer_sample_rate;
}

uint8_t wav_playback_driver_get_read_pin(void)
{
    return mzio_read_pin();
}


uint16_t wav_playback_driver_get_jitter_ticks(void)
{
    return 0U;
}

ISR(TIMER3_COMPA_vect)
{
    if (driver_state != WAV_PLAYBACK_DRIVER_RUNNING)
    {
        wav_playback_disable_timer_from_isr();
        driver_state = WAV_PLAYBACK_DRIVER_BAD_ARGUMENT;
        return;
    }

    if (!wav_playback_emit_one_sample_from_isr())
    {
        wav_playback_disable_timer_from_isr();
        mz_read_set_fast_from_isr(0U);

        driver_state = wav_sample_stream_finished_fast_from_isr() ?
            WAV_PLAYBACK_DRIVER_FINISHED : WAV_PLAYBACK_DRIVER_UNDERRUN;
        return;
    }

    wav_playback_schedule_period_from_isr();
}
