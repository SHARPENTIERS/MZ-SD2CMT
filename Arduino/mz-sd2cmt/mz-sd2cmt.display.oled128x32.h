#pragma once

#include <SSD1306Ascii.h> // Sketch > Include library > Manage libraries > search: SSD1306Ascii, by Bill Greiman https://github.com/greiman/SSD1306Ascii
#include <SSD1306AsciiAvrI2c.h>

// standard ascii 5x7 font
GLCDFONTDECL(AsciiFont5x7) =
{
	0x0, 0x0, // size of zero indicates fixed width font
	0x05, // width
	0x07, // height
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	0x00, 0x00, 0x00, 0x00, 0x00  // #255 NBSP
};

struct OLED128x32Display : DummyDisplay
{
	struct Config
	{
		bool enabled = !!HAS_OLED128X32_DISPLAY;
		int scroll_speed = 100; // Text scroll delay
		int scroll_wait = 2000; // Delay before scrolling starts
	} cfg;

	static constexpr auto I2C_ADDR = 0x3C;

	SSD1306AsciiAvrI2c oled;
	bool               present = false;
	byte               scroll_pos = 0;
	char               scroll_dir = 0;
	unsigned long      scroll_time;

	/// This function displays a text on the first line with a horizontal scrolling if necessary.
	void scrollText(char* text, bool refresh_all = true)
	{
		if (!present) return;

		const auto n = oled.strWidth(text);
		const auto w = oled.fontWidth();
		int i = min(scroll_pos, n) / w;

		if (refresh_all)
		{
			oled.clear();
		}
		oled.set1X();
		oled.setCursor(12 - (scroll_pos % w), 0);
		oled.print(text + i);
		if (!refresh_all)
		{
			oled.write(' ');
		}
		oled.setCursor(0, 0);
		oled.set2X();
		oled.print("?/LWBB"[Storage.entry_type]);
		oled.set1X();
		if (refresh_all)
		{
			oled.setCursor(12, 1);
			if (Storage.entry_type > ENTRY_DIR)
				oled.print(ultrafast_enabled ? F("\x10: ultra-fast") : F("\x10: normal"));
			if (Storage.entry_exists)
			{
				oled.setCursor(0, 3);
				oled.setInvertMode(true);
				Storage.entry.printFileSize(&oled);
				oled.write(' ');
				Storage.entry.printModifyDateTime(&oled);
				oled.setInvertMode(false);
			}
		}
	}

	void setup()
	{
		if (Storage.configure(cfg, "/.config/OLED128x32.display"))
		{
			Wire.begin();
			Wire.beginTransmission(I2C_ADDR);
			if (Wire.endTransmission() == 0)
			{
				present = true;
				oled.begin(&Adafruit128x32, I2C_ADDR);
				oled.setFont(AsciiFont5x7);
				oled.clear();
				oled.set2X();
				oled.print(F("[SD2MZCMT]"));
				oled.set1X();
				
				Serial.println(F("Output device: OLED 128x32 screen."));
			}

			scroll_time = millis() + cfg.scroll_wait;
		}
	}

	void initSdErrorHalt()
	{
		if (present)
		{
			oled.clear();
			oled.set2X();
			oled.println(F("SD2MZCMT"));
			oled.set1X();
		}
		Storage.sd.initErrorPrint(&oled);
	}

	void displayCode(DisplayCode code, Device *device)
	{
		if (!present) return;

		static unsigned long start_time = millis();
		static byte          old_progress = 0;
		switch (code)
		{
		case DisplayCode::no_sdcard:
			oled.clear();
			oled.print(F("MZ-SD2CMT: No SD card"));
			break;

		case DisplayCode::set_entry_name:
			scroll_time = millis() + cfg.scroll_wait;
			scroll_pos = 0;
			scrollText(Storage.lfn);
			break;

		case DisplayCode::scroll_entry_name:
			if (millis() >= scroll_time)
			{
				auto n = oled.strWidth(Storage.lfn) - oled.fontWidth();
				switch (scroll_dir)
				{
				case +1:
					if (n - scroll_pos > oled.displayWidth())
					{
						scroll_time = millis() + cfg.scroll_speed;
						scrollText(Storage.lfn, false);
						++scroll_pos;
					}
					else
					{
						scroll_dir = -1;
						scroll_time = millis() + cfg.scroll_wait;
						scrollText(Storage.lfn, false);
					}
					break;
				case -1:
					if (scroll_pos > 0)
					{
						scroll_time = millis() + cfg.scroll_speed;
						--scroll_pos;
						scrollText(Storage.lfn, false);
					}
					else
					{
						scroll_dir = +1;
						scroll_time = millis() + cfg.scroll_wait;
					}
					break;
				default:
					if (n - scroll_pos > oled.displayWidth())
					{
						scroll_time = millis();
						scroll_dir = +1;
					}
					break;
				}
			}
			break;

		case DisplayCode::start_playing:
			oled.clear();
			scroll_pos = 0;
			scrollText(Storage.lfn);
			oled.set2X();
			oled.setCursor(0, 2);
			oled.clearToEOL();
			oled.write('\x10');
			oled.set1X();
			oled.print(F("Playing... "));
			oled.setCursor(12, 3);
			oled.ssd1306WriteRam(255);
			for (auto i = 0; i < 5*16; ++i)
				oled.ssd1306WriteRam(129);
			oled.ssd1306WriteRam(255);
			start_time = millis();
			old_progress = 0;
			break;

		case DisplayCode::stop_playing:
			if (true)
			{
				auto stop_time = millis();
				oled.set2X();
				oled.setCursor(0, 2);
				oled.clearToEOL();
				oled.write('\xFB');
				oled.set1X();
				oled.print(F("Done. "));
				oled.set2X();
				oled.print((stop_time - start_time + 999) / 1000);
				oled.set1X();
				oled.print(F("s."));
			}
			break;

		case DisplayCode::cancel_playing:
			if (true)
			{
				auto cancel_time = millis();
				oled.set2X();
				oled.setCursor(0, 2);
				oled.clearToEOL();
				oled.write('X');
				oled.set1X();
				oled.print(F("Canceled. "));
				oled.set2X();
				oled.print((cancel_time - start_time + 999) / 1000);
				oled.set1X();
				oled.print(F("s."));
				oled.set1X();
			}
			break;

		case DisplayCode::pause_playing:
			oled.set2X();
			oled.setCursor(0, 2);
			oled.write('\x13');
			oled.set1X();
			oled.print(F("Paus"));
			break;

		case DisplayCode::resume_playing:
			oled.set2X();
			oled.setCursor(0, 2);
			oled.write('\x10');
			oled.set1X();
			oled.print(F("Play"));
			break;

		case DisplayCode::update_progress_bar:
			if (progress_size < 5 * 16)
			{
				auto new_progress = old_progress;
				old_progress = byte(progress_size);
				oled.setCursor(13 + new_progress, 3);
				while (new_progress < old_progress)
				{
					oled.ssd1306WriteRam(128+32+16+8+4+1);
					++new_progress;
				}
			}
			break;

		case DisplayCode::calibrate_device:
			if (device)
			{
			// oled.clear();
			// oled.set2X();
			// oled.print(device->name);
			// oled.set1X();
			// oled.setCursor(0, 1);
			// oled.print(F("Calibrating..."));
			// oled.setCursor(0, 2);
			// oled.print(device->calibrate_device_message);
			}
			break;

		default:
			break;
		}
	}
};
